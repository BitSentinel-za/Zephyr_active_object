## CMakeLists.txt
```
cmake_minimum_required(VERSION 3.20.0)
find_package(Zephyr REQUIRED HINTS $ENV{ZEPHYR_BASE})

project(wrapper C ASM CXX)

set(CMAKE_C_STANDARD 11)
set(CMAKE_CXX_STANDARD 14)

include_directories( src/control_thread src/event src/application)

# Add our main executable
FILE(GLOB app_sources src/*.cpp 
                      src/control_thread/*.cpp 
                      src/control_thread/*.h
                      src/event/*cpp
                      src/event/*h
                      src/application/*cpp
                      src/application/*.h)

target_sources(app PRIVATE ${app_sources}) 
```

## sample.yaml
```
sample:
  description: A basic demo to showcase multi-threading using K_THREAD_DEFINE
  name: Basic Thread Demo
tests:
  sample.basic.threads:
    tags:
      - kernel
      - threads
      - gpio
    filter: dt_enabled_alias_with_parent_compat("led0", "gpio-leds") and
            dt_enabled_alias_with_parent_compat("led1", "gpio-leds")
    integration_platforms:
      - nrf52833dk_nrf52820
    depends_on: gpio
    harness: console
    harness_config:
      type: multi_line
      ordered: false
      regex:
        - "Toggled led0; counter=(.*)"
        - "Toggled led1; counter=(.*)"
```

## prj.conf
```kconfig
# CONFIG_PRINTK=y
# CONFIG_ASSERT=y
# CONFIG_GPIO=y
# CONFIG_LOG=y
# CONFIG_FLASH=y
# CONFIG_HEAP_MEM_POOL_SIZE=16384
# CONFIG_NEWLIB_LIBC=y
# CONFIG_BOOTLOADER_MCUBOOT=y

CONFIG_LIB_CPLUSPLUS=y
CONFIG_CPP=y
CONFIG_HEAP_MEM_POOL_SIZE=256
CONFIG_STD_CPP14=y
CONFIG_CPP_MAIN=y
CONFIG_CPLUSPLUS=y
CONFIG_GLIBCXX_LIBCPP=y
```

## src/main.cpp
```c
#include <iostream>
#include <cstdint>

#include "control_thread.h"
#include "app_main.h"
#include "sys_event.h"


int main(void)
{

    Event main_event;
    app_main("app_main/", 5U, 500U , &main_event);

    return 0;
}
```
